## linux/crypto/Kconfig.fs2_6.patch
```kconfig
diff --git a/crypto/Kconfig b/crypto/Kconfig
index c442f2e..367d0e0 100644
--- a/crypto/Kconfig
+++ b/crypto/Kconfig
@@ -341,6 +341,8 @@ config CRYPTO_TEST
 	help
 	  Quick & dirty crypto test module.
 
+source "crypto/ocf/Kconfig"
+
 source "drivers/crypto/Kconfig"
 endmenu
 
diff --git a/crypto/Kconfig b/crypto/Kconfig
index c442f2e..367d0e0 100644
--- a/crypto/Kconfig
+++ b/crypto/Kconfig
@@ -341,6 +341,8 @@ config CRYPTO_TEST
 	help
 	  Quick & dirty crypto test module.
 
+source "crypto/ocf/Kconfig"
+
 source "drivers/crypto/Kconfig"
 endmenu
 
```

## linux/crypto/ocf/Kconfig
```kconfig
menu "OCF Configuration"

config OCF_OCF
	tristate "OCF (Open Cryptograhic Framework)"
	help
	  A linux port of the OpenBSD/FreeBSD crypto framework.

config OCF_FIPS
	tristate "enable fips RNG checks"
	depends on OCF_OCF
	help
	  Run all RNG provided data through a fips check before
	  adding it /dev/random's entropy pool.

config OCF_CRYPTODEV
	tristate "cryptodev (user space support)"
	depends on OCF_OCF
	help
	  The user space API to access crypto hardware.

config OCF_CRYPTOSOFT
	tristate "cryptosoft (software crypto engine)"
	depends on CRYPTO && OCF_OCF
	help
	  A software driver for the OCF framework that uses
	  the kernel CryptoAPI.

config OCF_SAFE
	tristate "safenet (HW crypto engine)"
	depends on OCF_OCF
	help
	  A driver for a number of the safenet Excel crypto accelerators.
	  Currently tested and working on the 1141 and 1741.

config OCF_IXP4XX
	tristate "IXP4xx (HW crypto engine)"
	depends on OCF_OCF && ARM
	help
	  XScale IXP4xx crypto accelerator driver.  Requires the
	  Intel Access library.

config OCF_HIFN
	tristate "Hifn Vulcan (HW crypto engine)"
	depends on OCF_OCF
	help
	  OCF driver for various HIFN based crypto accelerators (VULCAN)
	  (7951, 7955, 7956, 7751, 7811)

config OCF_HIFN_PKMMAP
	tristate "Hifn Vulcan mmap interface (/dev/vulcanpk)"
	depends on OCF_HIFN
	help
	  Enables direct access to the vulcan PK engine via /dev/vulcanpk.
          Turning this on disables the OCF interface for the PK engine.

config OCF_HIFNHIPP
	tristate "Hifn HIPP (HW packet crypto engine)"
	depends on OCF_OCF
	help
	  OCF driver for various HIFN based crypto accelerators (HIPP)
	  (7855)

config OCF_TALITOS
	tristate "talitos (HW crypto engine)"
	depends on OCF_OCF
	help
	  OCF driver for Freescale's security engine (SEC/talitos).

config OCF_BENCH
	tristate "ocf-bench (HW crypto in-kernel benchmark)"
	depends on OCF_OCF
	help
	  A very simple encryption test for the in-kernel interface
	  of OCF.  Also includes code to benchmark the IXP Access library
	  for comparison.

endmenu
```

## linux/net/ipsec/Kconfig
```kconfig
#
# IPSEC configuration
# Copyright (C) 2004 Michael Richardson <mcr@freeswan.org>
#
# This program is free software; you can redistribute it and/or modify it
# under the terms of the GNU General Public License as published by the
# Free Software Foundation; either version 2 of the License, or (at your
# option) any later version.  See <http://www.fsf.org/copyleft/gpl.txt>.
#
# This program is distributed in the hope that it will be useful, but
# WITHOUT ANY WARRANTY; without even the implied warranty of MERCHANTABILITY
# or FITNESS FOR A PARTICULAR PURPOSE.  See the GNU General Public License
# for more details.
#

config KLIPS
	tristate "Libreswan IPsec (KLIPS)"
	default n
#	depends on NF_CONNTRACK && NETFILTER
	help
	  KLIPS is the Libreswan (www.libreswan.org) Kernel Level IP Security
	  system. It is extensively tested, and has interoperated with
	  many other systems.
	  It provides "ipsecX" devices on which one can do firewalling.
	  The Libreswan userland, is compatible with both KLIPS and NETKEY
	  You cannot build KLIPS and NETKEY inline into the kernel.

menu "KLIPS options"
	depends on KLIPS

config KLIPS_ESP
	bool 'Encapsulating Security Payload - ESP ("VPN")'
	default y
	help
	   This option provides support for the IPSEC Encapsulation Security
	   Payload (IP protocol 50) which provides packet layer content
           hiding, and content authentication.
	   It is recommended to enable this.  RFC2406

config KLIPS_AH
	bool 'Authentication Header - AH'
	default n
	help
           This option provides support for the IPSEC Authentication Header
           (IP protocol 51) which provides packet layer sender and content
           authentication. It does not provide for confidentiality.
	   It is not recommended to enable this.  RFC2402

config KLIPS_AUTH_HMAC_MD5
	bool 'HMAC-MD5 authentication algorithm'
	default y
	help
           The HMAC-MD5 algorithm is used by ESP (and AH) to guarantee packet
	   integrity. There is little reason not to include it.

config KLIPS_AUTH_HMAC_SHA1
	bool 'HMAC-SHA1 authentication algorithm'
	default y
	help
           The HMAC-SHA1 algorithm is used by ESP (and AH) to guarantee packet
	   integrity. SHA1 is a little slower than MD5, but is said to be
	   a bit more secure. There is little reason not to include it.

config KLIPS_ALG
	bool 'KLIPS_ALG software encryption'
	default y
	help
	   This option provides support for loading new algorithms into the
	   kernel for crypto use. You may disable this if using the
	   CONFIG_KLIPS_OCF option for hardware offload.

config KLIPS_ENC_CRYPTOAPI
	bool 'CryptoAPI algorithm interface'
	default y
	depends on KLIPS_ALG
	help
	   Enable the algorithm interface to make all CryptoAPI 1.0 algorithms
	   available to KLIPS.

config KLIPS_ENC_3DES
	bool '3DES encryption algorithm'
	default y
	help
           The 3DES algorithm is used by ESP to provide for packet privacy.
	   3DES is 3-repeats of the DES algorithm. 3DES is widely supported,
	   and analyzed and is considered very secure. 1DES is not supported.

config KLIPS_ENC_AES
	bool 'AES encryption algorithm'
	default y
	depends on KLIPS_ALG
	help
           The AES algorithm is used by ESP to provide for packet privacy.
	   AES the NIST replacement for DES. AES is being widely analyzed,
           and is very fast.

config KLIPS_IPCOMP
	bool 'IP compression'
	default y
	help
           The IPcomp protocol is used prior to ESP to make the packet
	   smaller. Once encrypted, compression will fail, so any link
	   layer efforts (e.g. PPP) will not work.

config KLIPS_OCF
	bool 'IPsec OCF Acceleration Support'
	default n
	help
	   OCF provides Asynchronous crypto acceleration for kernel and
	   user applications.   It supports various HW accelerators.
	   If you have OCF support enabled and wish IPsec to utilise
	   the hardware managed by OCF,  then enable this option.
	   OCF is a kernel patch, see http://ocf-linux.sourceforge.net/

config KLIPS_COMPAT_NAT_NFMARK
	bool 'IPsec: Backwards compatible NAT NFMARK'
	default n
	help
	   Pre-2.6.23 kernels requiring the NAT-Traversal patch use
	   the NFmark feature to mark packets for UDP decapsulation.
	   Kernels since 2.6.23 have native support and do not need
	   to place this nfmark - leaving all nfmark space available
	   to other kernel modules or userland applications. Leave this
	   off when using kernels > 2.6.23

config KLIPS_DEBUG
	bool 'IPsec debugging'
	default y
	help
           KLIPS includes a lot of debugging code. Unless there is a real
	   tangible benefit to removing this code, it should be left in place.
	   Debugging connections without access to kernel level debugging is
	   essentially impossible. Leave this on.

config KLIPS_IF_MAX
	int 'Maximum number of virtual interfaces'
	default 64
	range 4 256
	help
	   KLIPS creates virtual interfaces for tunnel purposes. At present
	   it keeps track of certain items in an array (FIX ME), and needs
	   to preallocate this array. Only a pointer is used per item.

config KLIPS_IF_NUM
	int 'Number of virtual interfaces to auto create'
	default 2
	range 0 256
	help
	   KLIPS will auto create a number of interfaces, any further interfaces
	   need to be created with tncfg.

endmenu
```

## linux/net/ipsec/defconfig
```kconfig
#
# Libreswan IPSec implementation, KLIPS kernel config defaults
#

#
# First, lets override stuff already set or not in the kernel config.
#
# We can't even think about leaving this off...
CONFIG_INET=y

#
# This must be on for subnet protection.
CONFIG_IP_FORWARD=y

# Shut off IPSEC masquerading if it has been enabled, since it will
# break the compile.  IPPROTO_ESP and IPPROTO_AH were included in
# net/ipv4/ip_masq.c when they should have gone into include/linux/in.h.
CONFIG_IP_MASQUERADE_IPSEC=n

#
# Next, lets set the recommended FreeS/WAN configuration.
#

# To config as static (preferred), 'y'.  To config as module, 'm'.
CONFIG_KLIPS=m

# To do tunnel mode IPSec, this must be enabled.
CONFIG_KLIPS_IPIP=y

# To enable authentication, say 'y'.   (Highly recommended)
CONFIG_KLIPS_AH=y

# Authentication algorithm(s):
CONFIG_KLIPS_AUTH_HMAC_MD5=y
CONFIG_KLIPS_AUTH_HMAC_SHA1=y

# To enable encryption, say 'y'.   (Highly recommended)
CONFIG_KLIPS_ESP=y

# modular algo extensions (and new ALGOs)
CONFIG_KLIPS_ALG=y

# Encryption algorithm(s):
CONFIG_KLIPS_ENC_3DES=y
CONFIG_KLIPS_ENC_AES=y

# Use CryptoAPI for ALG - by default, yes.
CONFIG_KLIPS_ENC_CRYPTOAPI=y

CONFIG_KLIPS_ENC_NULL=y

# IP Compression: new, probably still has minor bugs.
CONFIG_KLIPS_IPCOMP=y

# To enable userspace-switchable KLIPS debugging, say 'y'.
CONFIG_KLIPS_DEBUG=y

# OCF HW offloading, requires kernel patch
# CONFIG_KLIPS_OCF is not set

# NFMARK for old-style NAT-T UDP-decapsulation
# CONFIG_KLIPS_COMPAT_NAT_NFMARK is not set
```
